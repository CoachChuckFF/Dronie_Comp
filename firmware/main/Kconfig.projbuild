## firmware/main/Kconfig.projbuild
```kconfig
menu "Blizzard Device"
    menu "Device"

        choice BLIZZARD_DEVICE
            prompt "Blizzard Device Type"
            default DEVICE_SOC
            help
                Select the device for this firmware

        config DEVICE_SOC
            bool "SoC-It"
            help
                Pop lock and SoC-It

        config DEVICE_LB_SNOWFLAKE
            bool "LB Snowflake"
            help
                Sexy AF

        endchoice

    endmenu

    menu "Artnet"

        config ARTNET_QUE_SIZE
            int "Que Size"
            default 3
            range 0 13
            help
                Buffers incoming Artnet packets, probs only need 3.

        config ARTNET_PUSH_WAIT
            int "Push Max Wait"
            default 100
            range 0 255
            help
                Ticks to wait for list mutex, needs to be bigger than pop.

        config ARTNET_POP_WAIT
            int "Pop Max Wait"
            default 10
            range 0 255
            help
                Time to wait for list mutex, needs to be lower than push.

        config ARTNET_MAX_PACKET_SIZE
            int "Max Artnet Packet Size"
            default 1088
            range 0 2048
            help
                Biggest Packet size to buffer.

    endmenu

    menu "Ethernet"

        config ETHERNET_ENABLE
            bool "Enable Ethernet"
            default y
            help
                Enable the Ethernet

        choice PHY_MODEL
            prompt "Ethernet PHY"
            default PHY_LAN8720
            help
                Select the PHY driver to use for the example.

        config PHY_LAN8720
            bool "Microchip LAN8720 PHY"
            help
                Select this to use the Microchip LAN8720 PHY

        endchoice


        config PHY_ADDRESS
            int "PHY Address (0-31)"
            default 1
            range 0 31
            help
                Select the PHY Address (0-31) for the hardware configuration and PHY model.
                LAN8720 default 1 or 0


        choice PHY_CLOCK_MODE
            prompt "EMAC clock mode"
            default PHY_CLOCK_GPIO0_IN
            help
                Select external (input on GPIO0) or internal (output on GPIO0, GPIO16 or GPIO17) clock


        config PHY_CLOCK_GPIO0_IN
            bool "GPIO0 input"
            help
                Input of 50MHz refclock on GPIO0

        config PHY_CLOCK_GPIO0_OUT
            bool "GPIO0 output"
            help
                Output the internal 50MHz APLL clock on GPIO0

        config PHY_CLOCK_GPIO16_OUT
            bool "GPIO16 output"
            help
                Output the internal 50MHz APLL clock on GPIO16

        config PHY_CLOCK_GPIO17_OUT
            bool "GPIO17 output (inverted)"
            help
                Output the internal 50MHz APLL clock on GPIO17 (inverted signal)

        endchoice

        config PHY_CLOCK_MODE
            int
            default 0 if PHY_CLOCK_GPIO0_IN
            default 1 if PHY_CLOCK_GPIO0_OUT
            default 2 if PHY_CLOCK_GPIO16_OUT
            default 3 if PHY_CLOCK_GPIO17_OUT


        config PHY_USE_POWER_PIN
            bool "Use PHY Power (enable/disable) pin"
            default y
            help
                Use a GPIO "power pin" to power the PHY on/off during operation.
                Consult the example README for more details

        config PHY_POWER_PIN
            int "PHY Power GPIO"
            default 16
            range 0 33
            depends on PHY_USE_POWER_PIN
            help
                GPIO number to use for powering on/off the PHY.

        config PHY_SMI_MDC_PIN
            int "SMI MDC Pin"
            default 23
            range 0 33
            help
                GPIO number to use for SMI clock output MDC to PHY.

        config PHY_SMI_MDIO_PIN
            int "SMI MDIO Pin"
            default 18
            range 0 33
            help
            GPIO number to use for SMI data pin MDIO to/from PHY.

    endmenu


endmenu
```
