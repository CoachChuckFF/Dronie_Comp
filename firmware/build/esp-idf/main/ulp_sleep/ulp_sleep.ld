/* Variable definitions for ESP32ULP linker
 * This file is generated automatically by esp32ulp_mapgen.py utility.
 */

PROVIDE ( ulp_detect_high = 0x5000008c );
PROVIDE ( ulp_detect_low = 0x50000090 );
PROVIDE ( ulp_detected = 0x50000054 );
PROVIDE ( ulp_entry = 0x50000000 );
PROVIDE ( ulp_held_count = 0x50000098 );
PROVIDE ( ulp_last_read = 0x5000009c );
PROVIDE ( ulp_wake_up = 0x50000080 );
PROVIDE ( ulp_wakeup_count = 0x50000094 );
